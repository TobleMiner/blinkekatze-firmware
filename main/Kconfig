## main/Kconfig
```kconfig
menu "Blinkekatze"
	config BK_WLAN_CHANNEL
		int "WLAN channel"
		range 1 14
		default 6

	config BK_WLAN_REG
		bool "Override default WLAN country code"

	config BK_WLAN_REG_CODE
		depends on BK_WLAN_REG
		string "WLAN country code"
		default "00"

	choice BK_WIRELESS_KEY
		prompt "Wireless key"
		default BK_WIRELESS_KEY_FILE

		config BK_WIRELESS_KEY_FILE
			bool "Configure through main/assets/wireless_key"
			help
			  Point the symlink `main/assets/wireless_key` to any
			  32 byte file that will then be used as the
			  encryption and signing key for messages sent wirelessly
	endchoice

	menu "Experimental"
		config BK_GAUGE_DF_PROG
			bool "[DANGER, read help!] Program battery gauge data flash in circuit"
			default n
			help
			  Use experimental soft I2C to program battery gauge data flash
			  from ESP in circuit. I've bricked a few TI gauges through bugs
			  in dataflash upload procedures before. Thus I consider this
			  functionality to be potentially dangerous. It is not tested
			  thoroughly and can permanently break your battery gauge! Use
			  at your own risk.
	endmenu
endmenu
```
